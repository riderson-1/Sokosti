## boards/Nordic/Sokosti_nRF5340/Kconfig.Sokosti_nRF5340
```kconfig
config BOARD_SOKOSTI_NRF5340
	select SOC_NRF5340_CPUAPP_QKAA if BOARD_SOKOSTI_NRF5340_NRF5340_CPUAPP || \
		BOARD_SOKOSTI_NRF5340_NRF5340_CPUAPP_NS
	select SOC_NRF5340_CPUNET_QKAA if BOARD_SOKOSTI_NRF5340_NRF5340_CPUNET
```

## boards/Nordic/Sokosti_nRF5340/board.yml
```yaml
board:
  name: Sokosti_nRF5340
  full_name: Sokosti_nRF5340
  vendor: Nordic
  socs:
  - name: nrf5340
    variants:
    - name: ns
      cpucluster: cpuapp
```
